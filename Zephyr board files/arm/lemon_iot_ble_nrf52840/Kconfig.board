## Zephyr board files/arm/lemon_iot_ble_nrf52840/Kconfig.board
```kconfig
# nRF52840 Lemon IoT BLE board configuration

# Copyright (c) 2023 Aaron Mohtar & Co Pty Ltd
# Copyright (c) 2023 Nordic Semiconductor ASA
# SPDX-License-Identifier: Apache-2.0

config BOARD_LEMON_IOT_BLE_NRF52840
	bool "Lemon IoT BLE nRF52840"
	depends on SOC_NRF52840_QIAA
```

## Zephyr board files/arm/lemon_iot_ble_nrf52840/Kconfig.defconfig
```kconfig
# nRF52 DK NRF52840 board configuration

# Copyright (c) 2023 Aaron Mohtar & Co Pty Ltd
# Copyright (c) 2023 Nordic Semiconductor ASA
# SPDX-License-Identifier: Apache-2.0

if BOARD_LEMON_IOT_BLE_NRF52840

config BOARD
	default "lemon_iot_ble_nrf52840"

config BT_CTLR
   default BT

endif
```
